## package/sec-gate-fedid-binding/Config.in
```kconfig
config BR2_PACKAGE_SEC_GATE_FEDID_BINDING
	bool "sec-gate-fedid-binding"
	select BR2_PACKAGE_AFB_LIBAFB
	help
	  Federated identity and user management binding.
	  
	  https://github.com/redpesk-common/sec-gate-fedid-binding
```

## package/sec-gate-oidc/Config.in
```kconfig
config BR2_PACKAGE_SEC_GATE_OIDC
	bool "sec-gate-oidc"
	select BR2_PACKAGE_AFB_LIBAFB
	select BR2_PACKAGE_OPENSSL
	help
	  Secure gateway for WebSocket APIs with OpenID-connect support.
	  
	  https://github.com/redpesk-common/sec-gate-oidc
```

## package/sec-lsm-manager/Config.in
```kconfig
config BR2_PACKAGE_SEC_LSM_MANAGER
	bool "sec-lsm-manager"
	select BR2_PACKAGE_SEC_CYNAGORA
	help
	  Security LSM manager for redpesk.
	  
	  https://github.com/redpesk-core/sec-lsm-manager
```

## package/signal-composer-binding/Config.in
```kconfig
config BR2_PACKAGE_SIGNAL_COMPOSER_BINDING
	bool "signal-composer-binding"
	select BR2_PACKAGE_AFB_LIBAFB
	select BR2_PACKAGE_AFB_CMAKE_MODULES
	select BR2_PACKAGE_AFB_LIBCONTROLLER
	help
	  Signal composer service for managing and composing signals
	  from different sources (CAN, GPS, sensors, etc.)
	  
	  https://github.com/redpesk-common/signal-composer-binding
```

## package/signal-composer-plugins-n2k/Config.in
```kconfig
config BR2_PACKAGE_SIGNAL_COMPOSER_PLUGINS_N2K
	bool "signal-composer-plugins-n2k"
	select BR2_PACKAGE_SIGNAL_COMPOSER_BINDING
	select BR2_PACKAGE_CANBUS_BINDING
	help
	  Signal composer plugin for NMEA2000 messages handling.
	  Provides marine-specific signal processing.
	  
	  https://github.com/redpesk-samples/signal-composer-plugins-demo-n2k
```

## package/spawn-binding/Config.in
```kconfig
config BR2_PACKAGE_SPAWN_BINDING
	bool "spawn-binding"
	select BR2_PACKAGE_AFB_LIBAFB
	select BR2_PACKAGE_AFB_CMAKE_MODULES
	help
	  Binding for spawning scripts and binaries securely.
	  
	  https://github.com/redpesk-common/spawn-binding
```

## package/wifiap-binding/Config.in
```kconfig
config BR2_PACKAGE_WIFIAP_BINDING
	bool "wifiap-binding"
	select BR2_PACKAGE_AFB_LIBAFB
	select BR2_PACKAGE_AFB_CMAKE_MODULES
	help
	  WiFi Access Point service binding.
	  
	  https://github.com/redpesk-common/wifiap-binding
```
