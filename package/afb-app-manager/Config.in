## package/afb-app-manager/Config.in
```kconfig
config BR2_PACKAGE_AFB_APP_MANAGER
	bool "afb-app-manager"
	select BR2_PACKAGE_AFB_LIBAFB
	select BR2_PACKAGE_SEC_LSM_MANAGER
	help
	  Application Framework main service for app management.
	  
	  https://github.com/redpesk-core/afb-app-manager
```

## package/afb-binder/Config.in
```kconfig
config BR2_PACKAGE_AFB_BINDER
	bool "afb-binder"
	select BR2_PACKAGE_AFB_LIBAFB
	help
	  The binder implementation of redpesk Application Framework.
	  
	  https://github.com/redpesk-core/afb-binder
```

## package/afb-binding/Config.in
```kconfig
config BR2_PACKAGE_AFB_BINDING
	bool "afb-binding"
	help
	  Header files for developing redpesk bindings.
	  
	  https://github.com/redpesk-core/afb-binding
```

## package/afb-client/Config.in
```kconfig
config BR2_PACKAGE_AFB_CLIENT
	bool "afb-client"
	select BR2_PACKAGE_AFB_LIBAFB
	help
	  Common client for Application Framework Binder.
	  
	  https://github.com/redpesk-core/afb-client
```

## package/afb-cmake-modules/Config.in
```kconfig
config BR2_PACKAGE_AFB_CMAKE_MODULES
	bool "afb-cmake-modules"
	help
	  CMake modules for building redpesk bindings.
	  
	  https://github.com/redpesk-core/afb-cmake-modules
```

## package/afb-libafb/Config.in
```kconfig
config BR2_PACKAGE_AFB_LIBAFB
	bool "afb-libafb"
	select BR2_PACKAGE_JSON_C
	select BR2_PACKAGE_LIBMICROHTTPD
	select BR2_PACKAGE_OPENSSL
	help
	  The core library of the redpesk Application Framework Binder.
	  
	  https://github.com/redpesk-core/afb-libafb
```

## package/afb-libcontroller/Config.in
```kconfig
config BR2_PACKAGE_AFB_LIBCONTROLLER
	bool "afb-libcontroller"
	select BR2_PACKAGE_AFB_LIBAFB
	help
	  Application controller library for redpesk bindings.
	  
	  https://github.com/redpesk-common/afb-libcontroller
```

## package/afb-libglue/Config.in
```kconfig
config BR2_PACKAGE_AFB_LIBGLUE
	bool "afb-libglue"
	select BR2_PACKAGE_AFB_LIBAFB
	help
	  High level abstraction for non C/C++ languages (Lua, Python, NodeJs).
	  
	  https://github.com/redpesk-common/afb-libglue
```

## package/afb-libhelpers/Config.in
```kconfig
config BR2_PACKAGE_AFB_LIBHELPERS
	bool "afb-libhelpers"
	select BR2_PACKAGE_AFB_LIBAFB
	help
	  Application Framework helper library.
	  
	  https://github.com/redpesk-common/afb-libhelpers
```

## package/afb-libpython/Config.in
```kconfig
config BR2_PACKAGE_AFB_LIBPYTHON
	bool "afb-libpython"
	select BR2_PACKAGE_AFB_LIBAFB
	select BR2_PACKAGE_PYTHON3
	help
	  Python bindings for redpesk Application Framework.
	  Allows scripting, mocking, and quick prototyping.
	  
	  https://github.com/redpesk-common/afb-libpython
```

## package/afb-librust/Config.in
```kconfig
config BR2_PACKAGE_AFB_LIBRUST
	bool "afb-librust"
	select BR2_PACKAGE_AFB_LIBAFB
	select BR2_PACKAGE_HOST_RUSTC
	help
	  Rust bindings for redpesk Application Framework.
	  
	  https://github.com/redpesk-common/afb-librust
```

## package/afb-perm-check-ex/Config.in
```kconfig
config BR2_PACKAGE_AFB_PERM_CHECK_EX
	bool "afb-perm-check-ex"
	select BR2_PACKAGE_AFB_LIBAFB
	select BR2_PACKAGE_SEC_CYNAGORA
	help
	  AFB micro-service for querying cynagora permissions.
	  
	  https://github.com/redpesk-common/afb-perm-check-ex
```

## package/afb-test-py/Config.in
```kconfig
config BR2_PACKAGE_AFB_TEST_PY
	bool "afb-test-py"
	select BR2_PACKAGE_AFB_LIBPYTHON
	select BR2_PACKAGE_PYTHON3
	help
	  Unit test framework for AFB bindings.
	  
	  https://github.com/redpesk-common/afb-test-py
```

## package/afb-test/Config.in
```kconfig
config BR2_PACKAGE_AFB_TEST
	bool "afb-test"
	select BR2_PACKAGE_AFB_LIBAFB
	select BR2_PACKAGE_LUA
	help
	  Lua-based test framework for AFB bindings.
	  
	  https://github.com/redpesk-common/afb-test
```

## package/canbus-binding/Config.in
```kconfig
config BR2_PACKAGE_CANBUS_BINDING
	bool "canbus-binding"
	select BR2_PACKAGE_AFB_LIBAFB
	select BR2_PACKAGE_AFB_CMAKE_MODULES
	select BR2_PACKAGE_CAN_UTILS
	help
	  Low level CAN service for decoding and writing CAN bus.
	  Supports NMEA2000, J1939, CANopen protocols.
	  
	  https://github.com/redpesk-common/canbus-binding
```

## package/canbus-generator/Config.in
```kconfig
config BR2_PACKAGE_CANBUS_GENERATOR
	bool "canbus-generator"
	help
	  CAN signal code generator from JSON descriptions.
	  
	  https://github.com/redpesk-common/canbus-generator
```

## package/cloud-publication-binding/Config.in
```kconfig
config BR2_PACKAGE_CLOUD_PUBLICATION_BINDING
	bool "cloud-publication-binding"
	select BR2_PACKAGE_AFB_LIBPYTHON
	select BR2_PACKAGE_PYTHON3
	help
	  Cloud publication service for target data.
	  
	  https://github.com/redpesk-common/cloud-publication-binding
```

## package/flutter-engine/Config.in
```kconfig
config BR2_PACKAGE_FLUTTER_ENGINE
	bool "flutter-engine"
	depends on BR2_PACKAGE_HAS_LIBGL || BR2_PACKAGE_HAS_LIBGLES
	select BR2_PACKAGE_LIBDRM
	help
	  Flutter engine for embedded Linux.
	  
	  https://github.com/aspect-build/aspect-flutter-engine
```

## package/gps-binding/Config.in
```kconfig
config BR2_PACKAGE_GPS_BINDING
	bool "gps-binding"
	select BR2_PACKAGE_AFB_LIBAFB
	select BR2_PACKAGE_AFB_CMAKE_MODULES
	select BR2_PACKAGE_GPSD
	help
	  GPS service binding for redpesk.
	  
	  https://github.com/redpesk-common/gps-binding
```

## package/lvgl-hmi-lib/Config.in
```kconfig
config BR2_PACKAGE_LVGL_HMI_LIB
	bool "lvgl-hmi-lib"
	select BR2_PACKAGE_LVGL
	help
	  LVGL HMI library for embedded displays.
	  
	  https://github.com/redpesk-common/lvgl-hmi-lib
```

## package/modbus-binding/Config.in
```kconfig
config BR2_PACKAGE_MODBUS_BINDING
	bool "modbus-binding"
	select BR2_PACKAGE_AFB_LIBAFB
	select BR2_PACKAGE_LIBMODBUS
	help
	  Modbus protocol binding for industrial devices.
	  
	  https://github.com/redpesk-common/modbus-binding
```

## package/platform-info-binding/Config.in
```kconfig
config BR2_PACKAGE_PLATFORM_INFO_BINDING
	bool "platform-info-binding"
	select BR2_PACKAGE_AFB_LIBAFB
	select BR2_PACKAGE_AFB_CMAKE_MODULES
	help
	  Platform information service (hardware, build info, devices).
	  
	  https://github.com/redpesk-common/platform-info-binding
```

## package/platform-runtime-tools/Config.in
```kconfig
config BR2_PACKAGE_PLATFORM_RUNTIME_TOOLS
	bool "platform-runtime-tools"
	help
	  Hardware detection, device settings, boot options, hotplug handling.
	  
	  https://github.com/redpesk-common/platform-runtime-tools
```

## package/redis-tsdb-binding/Config.in
```kconfig
config BR2_PACKAGE_REDIS_TSDB_BINDING
	bool "redis-tsdb-binding"
	select BR2_PACKAGE_AFB_LIBAFB
	select BR2_PACKAGE_REDIS
	help
	  Redis Timeseries database binding for data logging.
	  
	  https://github.com/redpesk-common/redis-tsdb-binding
```

## package/sec-cynagora/Config.in
```kconfig
config BR2_PACKAGE_SEC_CYNAGORA
	bool "sec-cynagora"
	help
	  Fast, simple and safe permission database service.
	  
	  https://github.com/redpesk-core/sec-cynagora
```
